## package/alsaplayer/Config.in
```kconfig
config BR2_PACKAGE_ALSAPLAYER
    bool "alsaplayer"
    depends on BR2_TOOLCHAIN_HAS_THREADS
    depends on BR2_USE_MMU # alsaplayer uses fork()
    select BR2_PACKAGE_ALSA_LIB
    select BR2_PACKAGE_LIBOGG
    select BR2_PACKAGE_LIBVORBIS
    help
      Alsaplayer is a PCM player designed specifically for use with ALSA.

      http://www.alsaplayer.org/
```

## package/stereoterm-shell/Config.in
```kconfig
config BR2_PACKAGE_STEREO_TERMINAL_SHELL
    bool "stereoterm-shell"
    help
        stereo terminal start package.

        https://stereoterminal.audio
```

## package/yaft/Config.in
```kconfig
config BR2_PACKAGE_YAFT
    bool "yaft"
    depends on BR2_TOOLCHAIN_HAS_THREADS
    depends on BR2_USE_WCHAR
    depends on BR2_TOOLCHAIN_HAS_SYNC_4
    help
      Yet Another Framebuffer Terminal (yaft) is a simple terminal
      emulator for systems that use the Linux framebuffer.

      https://github.com/uobikiemukot/yaft
```
